## drivers/metagross/Kconfig
```kconfig
#
# Helloworld driver as part of kernel source
#

 menu "Helloworld Driver"
comment "Helloworld Driver test config"


config HELLOWORLD
    bool "helloworld module"
    help
    Helloworld kernel module integrated as part of kernel source.
endmenu
```

## drivers/mfd/meta/Kconfig
```kconfig
menu "Menu toumi driver"

config TOUMI
	tristate "Active module"
	help
	  toumi test

endmenu
```
